## scripts/kconfig/Kconfig.kernel
```kconfig
#+++++++++++++++++++++++++++++++++++++++++++++++++++
choice
    prompt "Kernel Version"
    default LINUX-4.9.329

config  LINUX-3.18.y
    bool "linux-3.18.y"

config  LINUX-4.9.329
    bool "linux-4.9.329"
endchoice

config  HI_KERNEL_VERSION
    string
    default linux-3.18.y if LINUX-3.18.y
    default linux-4.9.329 if LINUX-4.9.329

config  HI_KERNEL_CFG
    prompt "Kernel Config File"
    string
    help
      Input config file for kernel. Such as xxxxx_defconfig.
      Config files are located in kernel source: arch/arm/configs.

#---------------------------------------------
config  HI_FS_BUILDIN
    bool "Build Rootfs in Kernel"
    default n
    help
      Say y to build rootfs in kernel.
#---------------------------------------------
config  HI_MSP_BUILDIN
    bool "Build MSP in Kernel"
    default n
    help
      Say y to build MSP modules in kernel.

#+++++++++++++++++++++++++++++++++++++++++++++++++++
```
